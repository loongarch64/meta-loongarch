## conf/layer.conf
```bitbake
# We have a conf and classes directory, add to BBPATH
BBPATH .= ":${LAYERDIR}"

# We have recipes-* directories, add to BBFILES
BBFILES += "${LAYERDIR}/recipes-*/*/*.bb \
            ${LAYERDIR}/recipes-*/*/*.bbappend"

BBFILE_COLLECTIONS += "meta-loongarch"
BBFILE_PATTERN_meta-loongarch = "^${LAYERDIR}/"
BBFILE_PRIORITY_meta-loongarch = "6"

LAYERDEPENDS_meta-loongarch = "core"
LAYERSERIES_COMPAT_meta-loongarch = "scarthgap"
```
